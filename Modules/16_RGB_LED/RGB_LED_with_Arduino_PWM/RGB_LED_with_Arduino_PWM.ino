// RGB LED + Встроенный генератор ШИМ

#define RED 2
#define GREEN 3
#define BLUE 4

void setup() {

  pinMode(RED, OUTPUT);
  pinMode(GREEN, OUTPUT);
  pinMode(BLUE, OUTPUT);
  analogWrite(RED, 255);

}

void loop() {
  
  for (int i = 0; i <= 255; i++) {
    analogWrite(GREEN, i);
    delay(5);
  }
  for (int i = 255; i >= 0; i--) {
    analogWrite(RED, i);
    delay(5);
  }
  for (int i = 0; i <= 255; i++) {
    analogWrite(BLUE, i);
    delay(5);
  }
  for (int i = 255; i >= 0; i--) {
    analogWrite(GREEN, i);
    delay(5);
  }
  for (int i = 0; i <= 255; i++) {
    analogWrite(RED, i);
    delay(5);
  }
  for (int i = 255; i >= 0; i--) {
    analogWrite(BLUE, i);
    delay(5);
  }

}


// Диод переливается всеми цветами:
//  1. Примем за начальную точку отсчета красный цвет (255, 0, 0).
//  2. Будем постепенно увеличивать значение зеленой составляющей G, пока не достигнем значения оранжевого (255, 125, 0), а затем и желтого цвета (255, 255, 0).
//  3. Постепенно уменьшим значение красной составляющей R до значения зеленого цвета (0, 255, 0).
//  4. Постепенно увеличим значение синей составляющей B до значения голубого цвета (0, 255, 255).
//  5. Постепенно уменьшим количество зеленой составляющей G до значения синего цвета (0, 0, 255).
//  6. Постепенно увеличим количество красной составляющей R до значения фиолетового цвета (255, 0, 255).
//  7. Выдерживаем небольшую паузу и переходим к шагу 1
